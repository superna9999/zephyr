/*
 * Copyright (c) 2017 Linaro Limited
 *
 * SPDX-License-Identifier: Apache-2.0
 */

/dts-v1/;
#include <st/stm32l053.dtsi>

/ {
	model = "STMicroelectronics STM32L053R8-NUCLEO board";
	compatible = "st,stm32l053r8-nucleo", "st,stm32l053";

	chosen {
		zephyr,console = &usart1;
		zephyr,sram = &sram0;
		zephyr,flash = &flash0;
	};
};

&usart1 {
	current-speed = <115200>;
	status = "ok";
};
