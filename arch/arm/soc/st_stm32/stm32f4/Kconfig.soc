## arch/arm/soc/st_stm32/stm32f4/Kconfig.soc
```kconfig
# Kconfig.soc - ST Microelectronics STM32F4 MCU line
#
# Copyright (c) 2016 Linaro Limited.
#
# SPDX-License-Identifier: Apache-2.0
#

choice
prompt "STM32F4x MCU Selection"
depends on SOC_SERIES_STM32F4X

config SOC_STM32F401XE
	bool "STM32F401XE"

config SOC_STM32F407XG
	bool "STM32F407XG"

config SOC_STM32F411XE
	bool "STM32F411XE"

config SOC_STM32F429XI
	bool "STM32F429XI"

endchoice

config STM32_ARM_MPU_ENABLE
	bool "Enable MPU"
	depends on CPU_HAS_MPU
	select ARM_MPU
	default n
	help
	  Enable MPU

choice
prompt "STM32F4x Flash MPU Permissions"
depends on STM32_ARM_MPU_ENABLE
default STM32_MPU_FLASH_RO

config STM32_MPU_FLASH_RO
	bool "Read-Only"

config STM32_MPU_FLASH_P_RW_U_NA
	bool "Privileged Read Write, Unprivileged No Access"

config STM32_MPU_FLASH_P_RW_U_RO
	bool "Privileged Read Write, Unprivileged Read Only"

config STM32_MPU_FLASH_FULL_ACCESS
	bool "Privileged Read Write, Unprivileged Read Write"

config STM32_MPU_FLASH_P_RO_U_NA
	bool "Privileged Read Only, Unprivileged No Access"

endchoice

choice
prompt "Configure Bootloader Options"
depends on MPU_ENABLE

config BL_BOOTLOADER
	bool "Build the Bootloader"

config BL_APPLICATION
	bool "Build an Application"

endchoice
```

## arch/arm/soc/st_stm32/stm32l0/Kconfig.defconfig.series
```kconfig
# Kconfig - ST Microelectronics STM32L0 MCU line
#
# Copyright (c) 2016 Open-RnD Sp. z o.o.
# Copyright (c) 2016 BayLibre, SAS
#
# SPDX-License-Identifier: Apache-2.0
#

if SOC_SERIES_STM32L0X

source "arch/arm/soc/st_stm32/stm32l0/Kconfig.defconfig.stm32l0*"

config SOC_SERIES
	default stm32l0

endif # SOC_SERIES_STM32L0X
```

## arch/arm/soc/st_stm32/stm32l0/Kconfig.defconfig.stm32l053x8
```kconfig
# Kconfig - ST Microelectronics STM32L053x8 MCU
#
# Copyright (c) 2016 BayLibre, SAS
#
# SPDX-License-Identifier: Apache-2.0
#

if SOC_STM32L053X8

config SOC
	string
	default stm32l053xx

config NUM_IRQS
	int
	default 39

endif # SOC_STM32L053X8
```

## boards/arm/nucleo_l053r8/Kconfig.board
```kconfig
# Kconfig - STM32L053R8 Nucleo board configuration
#
# Copyright (c) 2016 Open-RnD Sp. z o.o.
# Copyright (c) 2016 BayLibre, SAS
#
# SPDX-License-Identifier: Apache-2.0
#

config BOARD_NUCLEO_L053R8
	bool "Nucleo L053R8 Development Board"
	depends on SOC_STM32L053X8
```

## boards/arm/nucleo_l053r8/Kconfig.defconfig
```kconfig
# Kconfig - STM32L476RG Nucleo board configuration
#
# Copyright (c) 2016 Open-RnD Sp. z o.o.
# Copyright (c) 2016 BayLibre, SAS
#
# SPDX-License-Identifier: Apache-2.0
#

if BOARD_NUCLEO_L053R8

config BOARD
	default nucleo_l053r8

endif # BOARD_NUCLEO_L053R8
```

## boards/arm/nucleo_l053r8/nucleo_l053r8_defconfig
```kconfig
CONFIG_ARM=y
CONFIG_BOARD_STM32_NUCLEO_L053R8=y
CONFIG_SOC_FAMILY_STM32=y
CONFIG_SOC_SERIES_STM32L0X=y
CONFIG_SOC_STM32L053X8=y
CONFIG_CORTEX_M_SYSTICK=y
# 32MHz system clock
CONFIG_SYS_CLOCK_HW_CYCLES_PER_SEC=32000000

# enable uart driver
CONFIG_SERIAL=y
CONFIG_UART_STM32=y
CONFIG_UART_STM32_PORT_1=y

# enable pinmux
CONFIG_PINMUX=y
CONFIG_PINMUX_STM32=y

# enable GPIOs
CONFIG_GPIO=y
CONFIG_GPIO_STM32=y
CONFIG_GPIO_STM32_PORTA=y
CONFIG_GPIO_STM32_PORTB=y
CONFIG_GPIO_STM32_PORTC=y

# clock configuration
CONFIG_CLOCK_CONTROL=y
CONFIG_CLOCK_CONTROL_STM32_CUBE=y
# SYSCLK selection
CONFIG_CLOCK_STM32_SYSCLK_SRC_PLL=y
# PLL configuration
CONFIG_CLOCK_STM32_PLL_SRC_HSI
# produce 32MHz clock at PLL output
CONFIG_CLOCK_STM32_PLL_DIVISOR=2
CONFIG_CLOCK_STM32_PLL_MULTIPLIER=4
CONFIG_CLOCK_STM32_AHB_PRESCALER=1
CONFIG_CLOCK_STM32_APB1_PRESCALER=1
CONFIG_CLOCK_STM32_APB2_PRESCALER=1

# console
CONFIG_CONSOLE=y
CONFIG_UART_CONSOLE=y
CONFIG_UART_CONSOLE_ON_DEV_NAME="UART_1"
```

## boards/arm/pinetime_devkit/Kconfig
```kconfig
# Kconfig - PineTime Devkit board configuration
#
# Copyright (c) 2019 Neil Armstrong
#
# SPDX-License-Identifier: Apache-2.0

if BOARD_PINETIME_DEVKIT

config BOARD_ENABLE_DCDC
	bool "Enable DCDC mode"
	select SOC_DCDC_NRF52X
	default y

endif # BOARD_PINETIME_DEVKIT
```

## boards/arm/pinetime_devkit/Kconfig.board
```kconfig
# Kconfig - PineTime Devkit board configuration
#
# Copyright (c) 2019 Neil Armstrong
#
# SPDX-License-Identifier: Apache-2.0

config  BOARD_PINETIME_DEVKIT
	bool "PineTime Devkit"
	depends on SOC_NRF52832_QFAA
```

## boards/arm/pinetime_devkit/Kconfig.defconfig
```kconfig
# Kconfig - PineTime Devkit board configuration
#
# Copyright (c) 2019 Neil Armstrong
#
# SPDX-License-Identifier: Apache-2.0

if BOARD_PINETIME_DEVKIT

config BOARD
	default "pinetime_devkit"

if I2C

config I2C_0
	default y

endif # I2C

config BT_CTLR
	default BT

endif # BOARD_PINETIME_DEVKIT
```

## boards/arm/pinetime_devkit/pinetime_devkit_defconfig
```kconfig
# SPDX-License-Identifier: Apache-2.0

CONFIG_ARM=y
CONFIG_SOC_FAMILY_NRF=y
CONFIG_SOC_SERIES_NRF52X=y
CONFIG_SOC_NRF52832_QFAA=y
CONFIG_BOARD_PINETIME_DEVKIT=y

# Enable MPU
CONFIG_ARM_MPU=y

# enable GPIO
CONFIG_GPIO=y

# enable console
CONFIG_SERIAL=y
CONFIG_CONSOLE=y
CONFIG_STDOUT_CONSOLE=y

# enable debug RTT debug
CONFIG_RTT_CONSOLE=y
CONFIG_HAS_SEGGER_RTT=y
CONFIG_USE_SEGGER_RTT=y

# additional board options
CONFIG_GPIO_AS_PINRESET=y
```

## drivers/i2c/slave/Kconfig
```kconfig
# Kconfig - I2C Slave configuration options

#
# Copyright (c) 2017 BayLibre, SAS
#
# SPDX-License-Identifier: Apache-2.0
#

#
# I2C options
#
menuconfig I2C_SLAVE
	bool
	prompt "I2C Slave Drivers"
	depends on I2C
	default n
	help
	  Enable I2C Slave Driver Configuration

if I2C_SLAVE

config I2C_SLAVE_INIT_PRIORITY
	int
	default 60
	prompt "Init priority"
	help
	  I2C Slave device driver initialization priority.

config SYS_LOG_I2C_SLAVE_LEVEL
	int
	prompt "I2C Slave log level"
	depends on SYS_LOG
	default 0
	help
	  Sets log level for I2C drivers.
	  Levels are:
	  - 0 OFF, do not write
	  - 1 ERROR, only write SYS_LOG_ERR
	  - 2 WARNING, write SYS_LOG_WRN in addition to previous level
	  - 3 INFO, write SYS_LOG_INF in addition to previous levels
	  - 4 DEBUG, write SYS_LOG_DBG in addition to previous levels

config I2C_SLAVE_EEPROM
	bool "I2C Slave EEPROM driver"
	default n
	help
	  Enable virtual I2C Slave EEPROM driver

config I2C_SLAVE_EEPROM_SIZE
	int "I2C Slave EEPROM Size in KiB"
	default 1

config I2C_SLAVE_EEPROM_NAME
	string "I2C Slave EEPROM device name"
	default "EEPROM_SLAVE"

config I2C_SLAVE_EEPROM_CONTROLLER_DEV_NAME
	string "I2C Slave EEPROM Controller device name"
	default "I2C_0"

config I2C_SLAVE_EEPROM_ADDRESS
	hex "I2C Slave EEPROM address"
	default 0x56

endif # I2C_SLAVE
```

## drivers/memory/Kconfig
```kconfig
# Kconfig - memory controllers driver

#
# Copyright (c) 2017 BayLibre, SAS.
#
# SPDX-License-Identifier: Apache-2.0
#

menuconfig MEMORY
	bool
	prompt "Memory Controllers Drivers"
	default n
	help
	Enable options for memory controllers drivers.

if MEMORY

comment "Memory Controller Drivers"

source "drivers/memory/Kconfig.stm32"

endif
```
